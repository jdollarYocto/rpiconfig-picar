## conf/bblayers.conf
```bitbake
# POKY_BBLAYERS_CONF_VERSION is increased each time build/conf/bblayers.conf
# changes incompatibly
POKY_BBLAYERS_CONF_VERSION = "2"

BBPATH = "${TOPDIR}"
BBFILES ?= ""

BBLAYERS ?= " \
    /home/vagrant/poky/meta \
    /home/vagrant/poky/meta-poky \
    /home/vagrant/poky/meta-yocto-bsp \
    /home/vagrant/meta-openembedded/meta-oe \
    /home/vagrant/meta-openembedded/meta-multimedia \
    /home/vagrant/meta-openembedded/meta-networking \
    /home/vagrant/meta-openembedded/meta-python \
    /home/vagrant/meta-raspberrypi \
    /home/vagrant/workspace/meta-picar \
"
```
